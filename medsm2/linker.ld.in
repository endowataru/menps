
SECTIONS
{
    .dsm_data : ALIGN(${MEDSM2_GLOBAL_VAR_BLOCK_SIZE})
    {
        _dsm_data_begin = .;
        
        *(.dsm_data)
        
        . = ALIGN(${MEDSM2_GLOBAL_VAR_BLOCK_SIZE});
        
        _dsm_data_end = .;
    }
    
}

/* Insert .dsm_data after .ldata
   (the last section before any debugging sections). */
INSERT BEFORE .stab;

